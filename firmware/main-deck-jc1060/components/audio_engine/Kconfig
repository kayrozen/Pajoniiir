## firmware/main-deck-jc1060/components/audio_engine/Kconfig
```kconfig
menu "Audio engine"

config AUDIO_SCRATCH_ENABLED
    bool "Enable vinyl/scratch mode (jog platter scratches the audio)"
    default n
    help
        When enabled, touching the FLX4 jog platter top while a deck plays
        scratches the audio (forward + reverse) by driving a read head over the
        per-deck PSRAM scratch capture buffer, instead of the Phase 1 platter
        hold+scrub. Releasing seeks normal forward playback to the head position.
        Additive: with this off the output path is unchanged and touching the
        platter does the Phase 1 hold/scrub. See docs/VINYL_SCRATCH_PLAN.md.

config AUDIO_DISPLAY_LATENCY_MS
    int "Output latency past the UAC ring, for the displayed position (ms)"
    range 0 200
    default 18
    help
        The engine position counts frames when they are mixed; they become
        audible only after the output chain. The UI shows the position that
        was mixed this long ago: the measured UAC ring fill (smoothed, read
        by the UI) plus this constant, which covers the isoc URBs in flight
        (3 x 6 ms since v329, 3 x 4 ms before: default 12 then) and the
        controller's own buffering. v260 HB logs: ring
        ~830-1280 frames at 48 kHz (17-27 ms), so ~35 ms in total.
        Raise it if the waveform still leads the audio, 0 = ring only.

choice AUDIO_KEYLOCK_ALGO
    prompt "Master Tempo (key lock) algorithm"
    default AUDIO_KEYLOCK_WSOLA2
    help
        v326: WSOLA v2 (audio_keylock_wsola2.c) replaces the original WSOLA
        (audio_keylock.c): whole-frame grains of 32 ms with an 11 ms aligned
        crossfade, +/-10.7 ms normalised-correlation search, and the v325
        windowed-sinc rate conversion. v1 stays compiled as the fallback.
        v327: v2 on both decks by default. HIL v326 (P4 PROBE): v2 costs
        about 36 us per 16-frame group and deck, v1 about 50, so the A/B
        (v2 + v1) was the most expensive two-deck combination.

    config AUDIO_KEYLOCK_WSOLA1
        bool "WSOLA v1 on both decks (original)"
    config AUDIO_KEYLOCK_WSOLA2
        bool "WSOLA v2 on both decks"
    config AUDIO_KEYLOCK_AB_DECK1
        bool "A/B: WSOLA v2 on deck 1, v1 on deck 2"
        help
            Listening A/B: load the same track on both decks with Master
            Tempo on and the same tempo, and switch with the crossfader.
endchoice

endmenu
```

## firmware/main-deck-jc1060/components/bsp_jc4880/Kconfig
```kconfig
menu "Pajoniiir JC1060 BSP (jc4880 shim)"

config BSP_PCM5102A_MAIN_OUT
    bool "Enable PCM5102A main I2S output"
    default y
    help
        Upstream M2.2 gate (audio_engine.c): when enabled the engine takes
        bsp_audio_get_main_i2s_tx() and writes MAIN to the external PCM5102A
        DAC. Without it the main sink is a stub returning
        ESP_ERR_NOT_SUPPORTED and playback cannot pace.

config PAJ_MAIN_OUT_USB
    bool "Route MAIN output to the DDJ UAC sink instead of the PCM5102A"
    default n
    help
        When enabled the audio engine still pushes master+phones to the
        DDJ-FLX4 over UAC (4-channel), but the PCM5102A I2S MAIN path is
        withheld (bsp_audio_get_main_i2s_tx() returns NULL). When disabled,
        MAIN plays on the PCM5102A RCA output exactly like upstream M2.2.
        Headphone cue always goes through the DDJ UAC path; the onboard
        ES8311 codec is not used.

endmenu
```

## firmware/main-deck-jc1060/components/ui/Kconfig
```kconfig
menu "Pajoniiir UI"

config UI_DJUI_DIRECT_STRIPS
    bool "Blit the dj_ui zoom strips straight to the framebuffer (PPA)"
    default y
    help
        v287. The two zoom waveform strips leave LVGL's draw path: after each
        LVGL refresh the bridge burns the playhead, cue triangle and armed-loop
        trail into its ring strip and the PPA copies the view into the
        framebuffer. Off: LVGL draws them as images, as in v286.

        dj_ui is the only presentation layer since v293 (UI migration
        phase 6, docs/UI_MIGRATION_PLAN_DJUI.md); the former
        UI_PRESENTATION_DJUI switch and the legacy widgets are gone.

endmenu
```

## firmware/main-deck-jc1060/sdkconfig.defaults
```kconfig
# === upstream M2.2 defaults (base) ===
CONFIG_IDF_TARGET="esp32p4"
CONFIG_ESP32P4_SELECTS_REV_LESS_V3=y
CONFIG_ESP32P4_REV_MIN_100=y
CONFIG_ESP32P4_REV_MIN_FULL=100
CONFIG_ESPTOOLPY_FLASHSIZE_16MB=y
CONFIG_ESPTOOLPY_FLASHSIZE="16MB"
CONFIG_PARTITION_TABLE_CUSTOM=y
CONFIG_PARTITION_TABLE_CUSTOM_FILENAME="partitions.csv"
CONFIG_BOOTLOADER_APP_ROLLBACK_ENABLE=y
CONFIG_FREERTOS_HZ=1000
CONFIG_ESP_CONSOLE_UART_DEFAULT=y
CONFIG_LOG_DEFAULT_LEVEL_WARN=y
CONFIG_LOG_DEFAULT_LEVEL=2
CONFIG_COMPILER_OPTIMIZATION_PERF=y
CONFIG_SPIRAM=y
CONFIG_SPIRAM_USE_MALLOC=y
CONFIG_SPIRAM_MODE_HEX=y
CONFIG_IDF_EXPERIMENTAL_FEATURES=y
CONFIG_SPIRAM_SPEED_200M=y
CONFIG_SPIRAM_FETCH_INSTRUCTIONS=y
CONFIG_SPIRAM_RODATA=y
CONFIG_SPIRAM_XIP_FROM_PSRAM=y
CONFIG_SPIRAM_FLASH_LOAD_TO_PSRAM=y
CONFIG_SPIRAM_MALLOC_ALWAYSINTERNAL=256
CONFIG_ESP_MAIN_TASK_STACK_SIZE=16384
CONFIG_USB_HOST_HUBS_SUPPORTED=y
CONFIG_FATFS_LFN_HEAP=y
CONFIG_FATFS_MAX_LFN=255
CONFIG_FATFS_API_ENCODING_UTF_8=y
CONFIG_LV_COLOR_DEPTH_16=y
CONFIG_LV_FONT_MONTSERRAT_12=y
CONFIG_LV_FONT_MONTSERRAT_14=y
CONFIG_LV_FONT_MONTSERRAT_16=y
CONFIG_LV_FONT_MONTSERRAT_18=y
CONFIG_LV_FONT_MONTSERRAT_24=y
CONFIG_LV_FONT_MONTSERRAT_28=y
CONFIG_LV_USE_CLIB_MALLOC=y
CONFIG_SLAVE_IDF_TARGET_ESP32C6=y
CONFIG_ESP_HOSTED_CP_TARGET_ESP32C6=y
CONFIG_ESP_HOSTED_P4_DEV_BOARD_FUNC_BOARD=y
CONFIG_ESP_HOSTED_SDIO_HOST_INTERFACE=y
CONFIG_ESP_HOSTED_SDIO_SLOT_1=y
CONFIG_ESP_HOSTED_SDIO_4_BIT_BUS=y
CONFIG_ESP_HOSTED_MEMPOOL_PREFER_SPIRAM=y
CONFIG_WIFI_RMT_ENABLE_WPA3_SAE=y
CONFIG_WIFI_RMT_SOFTAP_SAE_SUPPORT=y
CONFIG_WIFI_RMT_STATIC_RX_BUFFER_NUM=16
CONFIG_WIFI_RMT_DYNAMIC_RX_BUFFER_NUM=64
CONFIG_WIFI_RMT_DYNAMIC_TX_BUFFER_NUM=64
CONFIG_WIFI_RMT_AMPDU_TX_ENABLED=y
CONFIG_WIFI_RMT_TX_BA_WIN=32
CONFIG_WIFI_RMT_AMPDU_RX_ENABLED=y
CONFIG_WIFI_RMT_RX_BA_WIN=32
CONFIG_LWIP_TCP_SND_BUF_DEFAULT=65534
CONFIG_LWIP_TCP_WND_DEFAULT=65534
CONFIG_LWIP_TCP_RECVMBOX_SIZE=64
CONFIG_LWIP_UDP_RECVMBOX_SIZE=64
CONFIG_LWIP_TCPIP_RECVMBOX_SIZE=64
CONFIG_LWIP_TCP_SACK_OUT=y
CONFIG_USB_HOST_CONTROL_TRANSFER_MAX_SIZE=512
CONFIG_BSP_PCM5102A_MAIN_OUT=y
CONFIG_LV_FONT_MONTSERRAT_20=y
CONFIG_LV_FONT_MONTSERRAT_22=y
CONFIG_ESP_COREDUMP_ENABLE_TO_FLASH=y
CONFIG_ESP_COREDUMP_CHECK_BOOT=y
CONFIG_ESP_COREDUMP_MAX_TASKS_NUM=8
CONFIG_ESP_COREDUMP_LOGS=n
CONFIG_ESP_TASK_WDT_PANIC=y
CONFIG_LOG_MAXIMUM_LEVEL_INFO=y
CONFIG_AUDIO_SCRATCH_ENABLED=y
# === JC1060 fork overrides ===
CONFIG_IDF_TARGET="esp32p4"
CONFIG_ESP32P4_SELECTS_REV_LESS_V3=y
CONFIG_ESP32P4_REV_MIN_100=y
CONFIG_ESP32P4_REV_MIN_FULL=100
CONFIG_IDF_EXPERIMENTAL_FEATURES=y
CONFIG_SPIRAM=y
CONFIG_SPIRAM_USE_MALLOC=y
CONFIG_SPIRAM_MODE_HEX=y
CONFIG_SPIRAM_SPEED_200M=y
CONFIG_SPIRAM_SIZE_OVERRIDE=16
CONFIG_ESP_MM_CACHE_MSYNC_C2M_CHUNKED_OPS=y
CONFIG_PARTITION_TABLE_CUSTOM=y
CONFIG_PARTITION_TABLE_CUSTOM_FILENAME="partitions.csv"
CONFIG_ESP_HOSTED_SDIO_CLOCK_FREQ_KHZ=40000
CONFIG_ESP_HOSTED_ENABLE_PEER_DATA_TRANSFER=y
CONFIG_ESP_HOSTED_MAX_CUSTOM_MSG_HANDLERS=8
CONFIG_ESP_HOSTED_HOST_RESTART_NO_COMMUNICATION_WITH_SLAVE_TIMEOUT=20
CONFIG_ESPTOOLPY_FLASHSIZE_16MB=y
CONFIG_ESPTOOLPY_FLASHSIZE="16MB"
CONFIG_CODEC_ES8311_SUPPORT=y
CONFIG_USB_HOST_HUBS_SUPPORTED=y
CONFIG_USB_HOST_CONTROL_TRANSFER_MAX_SIZE=1024
CONFIG_ESP_HOSTED_CP_TARGET_ESP32C6=y
CONFIG_ESP_HOSTED_SDIO_HOST_INTERFACE=y
CONFIG_ESP_HOSTED_P4_DEV_BOARD_FUNC_BOARD=y
CONFIG_ESP_HOSTED_SDIO_RESET_GPIO=54
CONFIG_ESP_HOSTED_SDIO_RESET_ACTIVE_HIGH=y
CONFIG_ESP_HOSTED_SLAVE_RESET_ONLY_IF_NECESSARY=y
CONFIG_ESP_HOSTED_SDIO_OPTIMIZATION_RX_STREAMING_MODE=y
CONFIG_ESP_HOSTED_MEMPOOL_PREFER_SPIRAM=y
CONFIG_ESP_HOSTED_PKT_STATS=y
CONFIG_ESP_HOSTED_PKT_STATS_INTERVAL_SEC=2
CONFIG_FREERTOS_HZ=1000
CONFIG_ESP_MAIN_TASK_STACK_SIZE=16384
CONFIG_ESP_CONSOLE_UART_BAUDRATE=115200
CONFIG_ESP_CONSOLE_SECONDARY_NONE=y
CONFIG_FATFS_LFN_HEAP=y
CONFIG_FATFS_API_ENCODING_UTF_8=y
CONFIG_BOOTLOADER_APP_ROLLBACK_ENABLE=y
CONFIG_ESP_HTTPS_OTA_ALLOW_HTTP=y
CONFIG_COMPILER_OPTIMIZATION_PERF=y
CONFIG_LOG_DEFAULT_LEVEL_WARN=y
CONFIG_LOG_DEFAULT_LEVEL=2
CONFIG_LOG_MAXIMUM_LEVEL_DEBUG=y
CONFIG_ESP_SYSTEM_USE_FRAME_POINTER=y
CONFIG_BOOTLOADER_LOG_LEVEL_NONE=y
CONFIG_BOOTLOADER_COMPILER_OPTIMIZATION_SIZE=y
CONFIG_ESP_BROWNOUT_DET=n
CONFIG_SPI_FLASH_WRITE_CHUNK_SIZE=512
CONFIG_SPI_FLASH_ERASE_YIELD_DURATION_MS=40
CONFIG_SPI_FLASH_ERASE_YIELD_TICKS=2
CONFIG_SPIRAM_XIP_FROM_PSRAM=y
CONFIG_LOG_MAXIMUM_LEVEL_DEBUG=y
CONFIG_ESP_CONSOLE_USB_SERIAL_JTAG=n
CONFIG_ESP_CONSOLE_UART_DEFAULT=y
CONFIG_ESP_CONSOLE_UART_NUM=0
CONFIG_ESP_CONSOLE_UART_BAUDRATE=115200
# === JC1060 v185b: upstream M2.2 early-boot options NOT valid on this board ===
# (crash before first log line -> bootloader rollback to v184)
# CONFIG_SPIRAM_FETCH_INSTRUCTIONS is not set
# CONFIG_SPIRAM_RODATA is not set
# CONFIG_SPIRAM_FLASH_LOAD_TO_PSRAM is not set
# === v185c TEMP DEBUG: route console (ROM+bootloader+panic) to GPIO37/38 so
# early-boot crashes of the v185 image are visible on the captured UART0.
# Fork v131 proven config; revert after the v185 crash is diagnosed.
CONFIG_ESP_CONSOLE_UART_CUSTOM=y
CONFIG_ESP_CONSOLE_UART_TX_GPIO=37
CONFIG_ESP_CONSOLE_UART_RX_GPIO=38

# v190: INFO logs for heap diagnostics
CONFIG_LOG_DEFAULT_LEVEL=3
CONFIG_SPIRAM_MALLOC_ALWAYSINTERNAL=64

# v240: USB-DWC DMA buffers (URB data, qTD lists) in PSRAM. HIL v239: after
# a DDJ replug the fragmented internal DMA heap refused the 3 x 2304 B isoc
# URBs (NO_MEM) on every UAC restart. Takes effect only when sdkconfig is
# regenerated (an existing sdkconfig keeps "is not set").
CONFIG_USB_HOST_DWC_DMA_CAP_MEMORY_IN_PSRAM=y
```
